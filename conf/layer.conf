## conf/layer.conf
```bitbake
# We have a conf and classes directory, add to BBPATH
BBPATH .= ":${LAYERDIR}"

# We have recipes-* directories, add to BBFILES
BBFILES += "${LAYERDIR}/recipes-*/*/*.bb \
	${LAYERDIR}/recipes-*/*/*.bbappend"

BBFILE_COLLECTIONS += "console-uart3"
BBFILE_PATTERN_console-uart3 = "^${LAYERDIR}/"
BBFILE_PRIORITY_console-uart3 = "6"
```
